## openembedded-test/conf/machine/tmtwinoe.conf
```bitbake
#@TYPE: Machine
#@NAME: Technomate Twin
#@DESCRIPTION: Machine configuration for the Technomate Twin

#take care when you do changes on MACHINE_ESSENTIAL_EXTRA_RDEPENDS/RRECOMMENDS you have to increment the recipes/tasks/task-boot.bb PR

MACHINE_ESSENTIAL_EXTRA_RDEPENDS += "kernel tm-dvb-modules kernel-module-dvb-core "

#take care when you do changes on MACHINE_ESSENTIAL_EXTRA_RDEPENDS/RRECOMMENDS you have to increment the recipes/tasks/task-boot.bb PR
MACHINE_ESSENTIAL_EXTRA_RRECOMMENDS = "\
	kernel-module-cdfs \
	"

module_autoload_nls-iso8859-15 = "nls-iso8859-15"
module_autoload_nls-cp850 = "nls-cp850"
module_autoload_nls-utf8 = "nls-utf8"
module_autoload_appletalk = "appletalk"
module_autoload_cifs = "cifs"
module_autoload_exportfs = "exportfs"
module_autoload_ext2 = "ext2"
module_autoload_cdfs = "cdfs"
module_autoload_ntfs = "ntfs"

MACHINE_EXTRA_RRECOMMENDS = " \
	gst-plugin-dvbmediasink \
	"

KERNEL_EXTRA_CMD = "--disable-compressor=lzo "

EXTRA_IMAGECMD_jffs2 = " --eraseblock=0x20000 -p -n -l --pagesize=0x800 "
IMAGE_CMD_jffs2 = " \
	rm -rf ${IMAGE_ROOTFS}/boot/*; \
	rm -rf ${IMAGE_ROOTFS}/tmp/*; \
	mkfs.jffs2 --root=${IMAGE_ROOTFS} \
		${KERNEL_EXTRA_CMD} \
		--compression-mode=size \
		--output=${DEPLOY_DIR_IMAGE}/${IMAGE_NAME}.rootfs.jffs2 \
		${EXTRA_IMAGECMD}; \
	gzip -f -c ${DEPLOY_DIR_IMAGE}/vmlinux-${MACHINE}.bin > ${DEPLOY_DIR_IMAGE}/vmlinux-${MACHINE}.bin.gz; \
	mkdir -p ${DEPLOY_DIR_IMAGE}/update/${MACHINE}/cfe; \
	cp ${DEPLOY_DIR_IMAGE}/splash.bmp ${DEPLOY_DIR_IMAGE}/update/${MACHINE}/cfe/splash.bmp; \
	mv ${DEPLOY_DIR_IMAGE}/${IMAGE_NAME}.rootfs.jffs2 ${DEPLOY_DIR_IMAGE}/update/${MACHINE}/cfe/oe_rootfs.bin; \
	mv ${DEPLOY_DIR_IMAGE}/vmlinux-${MACHINE}.bin.gz ${DEPLOY_DIR_IMAGE}/update/${MACHINE}/cfe/oe_kernel.bin; \
	cd ${DEPLOY_DIR_IMAGE}; \
	zip -r ${IMAGE_NAME}_usb.zip update/*; \
	rm -rf update; \
"

TARGET_FPU = "hard"

TARGET_ARCH = "mipsel"

MACHINE_FEATURES += "kernel26 alsa usbhost wifi"

# openpli specific features:
MACHINE_FEATURES += "32bpp hdtv switchoff lpcm textlcd dvbapi5 nofastscan fansetup"

# wifiusblegacy enables legacy external usb wlan drivers
MACHINE_FEATURES += "wifiusblegacy"

CHIPSET = "bcm7335"

MACHINE_KERNEL_PR = "r10"

PREFERRED_VERSION_linux-${MACHINE} = "2.6.18"
PREFERRED_VERSION_linux-libc-headers = "2.6.18"

OLDEST_KERNEL = "2.6.18"

TARGET_ARCH = "mipsel"

GLIBC_EXTRA_OECONF = "--with-tls"

PREFERRED_PROVIDER_virtual/kernel = "linux-${MACHINE}"

PREFERRED_PROVIDER_virtual/showiframe = "vuplus-dvb-tools"
PREFERRED_VERSION_mtd-utils = "1.3.1"
PREFERRED_VERSION_wpa-supplicant = "0.5.8"
PREFERRED_VERSION_madwifi-ng = "r3314-20080131"

require conf/machine/include/tune-mips32.inc

include conf/machine/include/autoload-usbserial.inc

SYSVINIT_ENABLED_GETTYS = "1"
```
